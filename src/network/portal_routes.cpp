#include "portal_routes.h"
#include "portal_apply.h"
#include "portal_command_gate.h"
#include "portal_page_logic.h"
#include "portal_stop.h"
#include "wifi_manager.h"
#include "../config/constants.h"
#include <Arduino.h>
#include <esp_heap_caps.h>
#include <esp_http_server.h>
#include <lwip/sockets.h>
#include <string.h>
#include "portal_page_data.h"  // generated by tools/build-scripts/embed_portal.py into the build directory

static_assert(PORTAL_PAGE_GZ_SIZE > 0 && PORTAL_PAGE_GZ_SIZE <= PORTAL_PAGE_BUDGET_BYTES,
              "embedded web panel page exceeds PORTAL_PAGE_BUDGET_BYTES");

namespace {

enum class HeaderRead : uint8_t { ABSENT, OK, OVERSIZE };

// Reads a request header into out. A value that does not fit is OVERSIZE (never silently truncated).
HeaderRead read_header(httpd_req_t* req, const char* name, char* out, size_t capacity) {
    out[0] = '\0';
    const size_t length = httpd_req_get_hdr_value_len(req, name);
    if (length == 0) return HeaderRead::ABSENT;
    if (length >= capacity) return HeaderRead::OVERSIZE;
    return httpd_req_get_hdr_value_str(req, name, out, capacity) == ESP_OK ? HeaderRead::OK : HeaderRead::ABSENT;
}

const char* status_line(int status) {
    switch (status) {
        case 200: return "200 OK";
        case 202: return "202 Accepted";
        case 400: return "400 Bad Request";
        case 403: return "403 Forbidden";
        case 409: return "409 Conflict";
        case 413: return "413 Payload Too Large";
        case 415: return "415 Unsupported Media Type";
        case 500: return "500 Internal Server Error";
        case 503: return "503 Service Unavailable";
        default: return "500 Internal Server Error";
    }
}

// Heap buffer for a JSON reply (the HTTP task has a 6 KB stack): PSRAM first, internal heap as the fallback
struct ReplyBuffer {
    char* data = nullptr;
    size_t capacity;
    explicit ReplyBuffer(size_t bytes) : capacity(bytes) {
        data = static_cast<char*>(heap_caps_malloc(bytes, MALLOC_CAP_SPIRAM | MALLOC_CAP_8BIT));
        if (!data) data = static_cast<char*>(heap_caps_malloc(bytes, MALLOC_CAP_8BIT));
    }
    ~ReplyBuffer() { heap_caps_free(data); }
    ReplyBuffer(const ReplyBuffer&) = delete;
    ReplyBuffer& operator=(const ReplyBuffer&) = delete;
};

int send_json_ok(httpd_req_t* req, const char* json, int status = 200) {
    if (status != 200) httpd_resp_set_status(req, status_line(status));
    httpd_resp_set_type(req, "application/json");
    httpd_resp_set_hdr(req, "Cache-Control", "no-store");
    httpd_resp_set_hdr(req, "Connection", "close");  // two sockets only: do not let a browser keep them idle
    return httpd_resp_send(req, json, HTTPD_RESP_USE_STRLEN);
}

// A reply that did not fit its buffer (or its buffer could not be allocated) is a firmware or memory problem,
// never the client's fault: answer with the documented, retryable 503 ui_busy
int send_internal_error(httpd_req_t* req) {
    LOG_BLE("[PORTAL] reply buffer unavailable or too small\n");
    return portal_send_error(req, PortalError::UI_BUSY);
}

// How deep the HTTP task got, logged once per route kind (the task has a small stack)
void log_stack_once(bool* done, const char* what) {
    if (*done) return;
    *done = true;
    LOG_BLE("[PORTAL] HTTP task stack %u bytes free after the first %s\n",
            (unsigned)(uxTaskGetStackHighWaterMark(nullptr) * sizeof(StackType_t)), what);
}

// Lingering close, same idea as the update routes: after an early error reply the client may still be sending
// its body. Closing at once could turn the reply into a TCP reset, so discard a bounded amount of it first.
void discard_request_body(httpd_req_t* req) {
    if (req->content_len == 0) return;
    const int fd = httpd_req_to_sockfd(req);
    if (fd >= 0) {
        struct timeval timeout = {1, 0};  // never wait long for a client that stopped sending
        setsockopt(fd, SOL_SOCKET, SO_RCVTIMEO, &timeout, sizeof(timeout));
    }
    char scratch[128];
    size_t discarded = 0;
    const uint32_t started = millis();
    while (discarded < UPDATE_LINGER_MAX_BYTES && millis() - started < UPDATE_LINGER_MAX_MS) {
        const int n = httpd_req_recv(req, scratch, sizeof(scratch));
        if (n <= 0) break;  // body complete, closed or no more data
        discarded += static_cast<size_t>(n);
    }
}

// Reads the whole request body (at most PORTAL_BODY_MAX bytes) into body. False with *error set: the refusal to send
// (EMPTY_BODY, BODY_TOO_LARGE); false with *error NONE: the client timed out or went away, nothing more to answer.
bool read_body(httpd_req_t* req, char* body, size_t* length, PortalError* error) {
    *error = PortalError::NONE;
    const size_t total = req->content_len;
    if (total == 0) {
        *error = PortalError::EMPTY_BODY;
        return false;
    }
    if (total > PORTAL_BODY_MAX) {
        *error = PortalError::BODY_TOO_LARGE;
        return false;
    }
    size_t got = 0;
    while (got < total) {
        const int n = httpd_req_recv(req, body + got, total - got);
        if (n <= 0) {
            if (n == HTTPD_SOCK_ERR_TIMEOUT) httpd_resp_send_408(req);
            return false;
        }
        got += static_cast<size_t>(n);
    }
    *length = total;
    return true;
}

// Headers every page reply carries (200 and 304)
void set_page_headers(httpd_req_t* req, const char* etag) {
    httpd_resp_set_hdr(req, "ETag", etag);
    httpd_resp_set_hdr(req, "Cache-Control", "no-cache");  // revalidate: a new firmware shows its new page
    httpd_resp_set_hdr(req, "X-Content-Type-Options", "nosniff");
    httpd_resp_set_hdr(req, "Referrer-Policy", "no-referrer");
    httpd_resp_set_hdr(req, "Content-Security-Policy", PORTAL_PAGE_CSP);
    httpd_resp_set_hdr(req, "Connection", "close");
}

}  // namespace

PortalError portal_route_admit(httpd_req* req, PortalRoute route) {
    if (!portal_route_enabled(route, wifi_manager.web_enabled(), wifi_manager.push_enabled())) {
        return portal_route_refusal(route);
    }

    char host[PORTAL_HEADER_MAX_LEN + 1];
    char origin[PORTAL_HEADER_MAX_LEN + 1];
    char content_type[PORTAL_HEADER_MAX_LEN + 1];
    char custom[PORTAL_HEADER_MAX_LEN + 1];
    const HeaderRead host_read = read_header(req, "Host", host, sizeof(host));
    const HeaderRead origin_read = read_header(req, "Origin", origin, sizeof(origin));
    const HeaderRead type_read = read_header(req, "Content-Type", content_type, sizeof(content_type));
    const HeaderRead custom_read = read_header(req, PORTAL_CUSTOM_HEADER_NAME, custom, sizeof(custom));

    // An oversize value is handed to the pure guards as something they refuse (empty Host, a non-http Origin)
    PortalRequestHeaders headers;
    headers.host = host_read == HeaderRead::OK ? host : (host_read == HeaderRead::OVERSIZE ? "" : nullptr);
    headers.origin = origin_read == HeaderRead::OK ? origin : (origin_read == HeaderRead::OVERSIZE ? "oversize" : nullptr);
    headers.content_type = type_read == HeaderRead::OK ? content_type : (type_read == HeaderRead::OVERSIZE ? "oversize" : nullptr);
    headers.custom = custom_read == HeaderRead::OK ? custom : (custom_read == HeaderRead::OVERSIZE ? "oversize" : nullptr);

    const bool state_changing = route == PortalRoute::API_WRITE || route == PortalRoute::API_COMMAND;
    return portal_check_request(headers, state_changing);
}

int portal_send_error(httpd_req* req, PortalError error) {
    const PortalErrorInfo& info = portal_error_info(error);
    char json[256];
    portal_encode_error(error, json, sizeof(json));
    httpd_resp_set_status(req, status_line(info.status));
    httpd_resp_set_type(req, "application/json");
    httpd_resp_set_hdr(req, "Cache-Control", "no-store");
    httpd_resp_send(req, json, HTTPD_RESP_USE_STRLEN);
    discard_request_body(req);  // a no-op for GET and for a body that was read completely
    return ESP_FAIL;
}

int portal_handle_page(httpd_req* req) {
    const PortalError refused = portal_route_admit(req, PortalRoute::PAGE);
    if (refused != PortalError::NONE) return portal_send_error(req, refused);

    char etag[PORTAL_PAGE_ETAG_MAX_LEN];
    portal_page_etag(BUILD_NUMBER, PORTAL_PAGE_GZ_CRC32, etag, sizeof(etag));

    char if_none_match[PORTAL_PAGE_ETAG_MAX_LEN * 2];
    if (read_header(req, "If-None-Match", if_none_match, sizeof(if_none_match)) == HeaderRead::OK &&
        portal_etag_matches(if_none_match, etag)) {
        httpd_resp_set_status(req, "304 Not Modified");
        set_page_headers(req, etag);
        httpd_resp_send(req, nullptr, 0);
        return ESP_OK;
    }

    httpd_resp_set_type(req, "text/html; charset=utf-8");
    httpd_resp_set_hdr(req, "Content-Encoding", "gzip");
    set_page_headers(req, etag);
    return httpd_resp_send(req, reinterpret_cast<const char*>(portal_page_gz), PORTAL_PAGE_GZ_SIZE);
}

//------------------------------------------------------------------------------
// JSON API
//------------------------------------------------------------------------------
int portal_handle_status(httpd_req* req) {
    const PortalError refused = portal_route_admit(req, PortalRoute::API_READ);
    if (refused != PortalError::NONE) return portal_send_error(req, refused);

    PortalStatus status;
    if (!portal_command_gate.read_snapshot(nullptr, &status)) return portal_send_error(req, PortalError::UI_BUSY);
    char json[PORTAL_STATUS_JSON_MAX];
    if (!portal_encode_status(status, json, sizeof(json))) return send_internal_error(req);
    static bool stack_logged = false;
    const int sent = send_json_ok(req, json);
    log_stack_once(&stack_logged, "GET /api/status");
    return sent;
}

int portal_handle_settings_get(httpd_req* req) {
    const PortalError refused = portal_route_admit(req, PortalRoute::API_READ);
    if (refused != PortalError::NONE) return portal_send_error(req, refused);

    PortalValues values;
    if (!portal_command_gate.read_snapshot(&values, nullptr)) return portal_send_error(req, PortalError::UI_BUSY);
    ReplyBuffer json(PORTAL_VALUES_JSON_MAX);
    if (!json.data || !portal_encode_values(values, json.data, json.capacity)) return send_internal_error(req);
    static bool stack_logged = false;
    const int sent = send_json_ok(req, json.data);
    log_stack_once(&stack_logged, "GET /api/settings");
    return sent;
}

int portal_handle_schema(httpd_req* req) {
    const PortalError refused = portal_route_admit(req, PortalRoute::API_READ);
    if (refused != PortalError::NONE) return portal_send_error(req, refused);

    ReplyBuffer json(PORTAL_SCHEMA_JSON_MAX);
    if (!json.data || !portal_encode_schema(json.data, json.capacity)) return send_internal_error(req);
    return send_json_ok(req, json.data);
}

int portal_handle_settings_patch(httpd_req* req) {
    const PortalError refused = portal_route_admit(req, PortalRoute::API_WRITE);
    if (refused != PortalError::NONE) return portal_send_error(req, refused);

    char body[PORTAL_BODY_MAX];
    size_t length = 0;
    PortalError body_error = PortalError::NONE;
    if (!read_body(req, body, &length, &body_error)) {
        return body_error == PortalError::NONE ? ESP_FAIL : portal_send_error(req, body_error);
    }

    PortalPatch patch;
    const PortalError invalid = portal_parse_patch(body, length, &patch);
    if (invalid != PortalError::NONE) return portal_send_error(req, invalid);

    // The UI task applies it through the same handlers as the touchscreen (portal_ui_controller.cpp)
    PortalMailboxResult result;
    const PortalError submitted = portal_command_gate.submit_patch(patch, &result);
    if (submitted != PortalError::NONE) return portal_send_error(req, submitted);
    if (result.error != PortalError::NONE) return portal_send_error(req, result.error);

    ReplyBuffer json(PORTAL_VALUES_JSON_MAX);
    if (!json.data || !portal_encode_patch_result(result, json.data, json.capacity)) return send_internal_error(req);
    static bool stack_logged = false;
    const int sent = send_json_ok(req, json.data);
    log_stack_once(&stack_logged, "PATCH /api/settings");
    return sent;
}

int portal_handle_command(httpd_req* req) {
    const PortalError refused = portal_route_admit(req, PortalRoute::API_COMMAND);
    if (refused != PortalError::NONE) return portal_send_error(req, refused);

    char body[PORTAL_BODY_MAX];
    size_t length = 0;
    PortalError body_error = PortalError::NONE;
    if (!read_body(req, body, &length, &body_error)) {
        return body_error == PortalError::NONE ? ESP_FAIL : portal_send_error(req, body_error);
    }

    PortalCommandRequest request;
    const PortalError invalid = portal_parse_command(body, length, &request);
    if (invalid != PortalError::NONE) return portal_send_error(req, invalid);

    if (request.cmd == PortalCommand::STOP) {
        // Never queued and never waits for the UI task (portal_stop.h): accepted whatever else is going on
        portal_stop_now();
    } else {
        // The UI task decides and runs it through the same handlers as the touchscreen (portal_ui_controller.cpp)
        PortalMailboxResult result;
        const PortalError submitted = portal_command_gate.submit_command(request, &result);
        if (submitted != PortalError::NONE) return portal_send_error(req, submitted);
        if (result.error != PortalError::NONE) return portal_send_error(req, result.error);
    }

    char json[PORTAL_COMMAND_REPLY_MAX];
    if (!portal_encode_command_reply(request, json, sizeof(json))) return send_internal_error(req);
    // Separate once-flags: the stop branch and the mailbox branch reach different depths
    static bool stop_stack_logged = false;
    static bool mailbox_stack_logged = false;
    const bool is_stop = request.cmd == PortalCommand::STOP;
    const int sent = send_json_ok(req, json, portal_command_success_status(request.cmd));
    log_stack_once(is_stop ? &stop_stack_logged : &mailbox_stack_logged,
                   is_stop ? "POST /api/command stop" : "POST /api/command (mailbox)");
    return sent;
}
